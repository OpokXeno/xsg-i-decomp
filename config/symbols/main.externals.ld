/* symbols accepted unit records take from other units (witnessed overlay addresses) */
PROVIDE(dataPlChaGet = 0x00a19210); /* ov01 */
PROVIDE(dataCidGet = 0x00a1a2e8); /* ov01 */
PROVIDE(dataWpnGet = 0x00a1a3d8); /* ov01 */
PROVIDE(dataAttGet = 0x00a1a428); /* ov01 */
PROVIDE(dataFrmGet = 0x00a1a598); /* ov01 */
PROVIDE(dataEngGet = 0x00a1a5e8); /* ov01 */
