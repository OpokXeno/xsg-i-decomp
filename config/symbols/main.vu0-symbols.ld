/* generated by tools/vu_audit.py from the assembled object -- do not edit.
   VU0 instruction-memory byte addresses; the EE callers shift to pairs. */
Vu0CallSin = 0x020;
Vu0CallCos = 0x0E8;
Vu0CallMatrixStackUnit = 0x108;
Vu0CallMatrixStackMul = 0x130;
Vu0CallMatrixStackReverse = 0x1B8;
Vu0CallMatrixStackInverse = 0x218;
Vu0CallMatrixStackScale = 0x2E8;
Vu0CallMatrixStackTrans = 0x310;
Vu0CallMatrixStackRotV = 0x338;
Vu0CallMatrixStackRotX = 0x3D0;
Vu0CallMatrixStackRotY = 0x418;
Vu0CallMatrixStackRotZ = 0x460;
Vu0CallMatrixStackFrustum = 0x4A8;
Vu0CallMatrixStackPushUnit = 0x538;
Vu0CallMatrixStackPush = 0x580;
Vu0CallMatrixStackPop = 0x5C8;
Vu0CallMatrixStackMulVector = 0x620;
Vu0CallMatrixStackRTPS = 0x648;
Vu0CallLightCalcMatrix = 0x6A8;

/* Original VU1 overlay execution labels, not EE upload addresses.
 * SLUS_204.69 SHA-256: 412d448de31505c03ad474cc63d500b3b4f8c48d49d32bd24c89fe5b21af0fb2.
 * Symbol values transported without changing or crediting any VU payload. */
NewVu1EnvGsKick = 0x0;
NewVu1EnvGsKickWide = 0x28;
NewVu1GsKick = 0x0;
NewVu1GsKickWide = 0x28;
NewVu1ProGsKick = 0x0;
NewVu1ProGsKickWide = 0x28;
NewVu1AddEnvGsKick = 0x0;
NewVu1AddEnvGsKickWide = 0x28;
NewVu1AddGsKick = 0x0;
NewVu1AddGsKickWide = 0x28;
NewVu1TexEnvGsKick = 0x0;
NewVu1TexEnvGsKickWide = 0x28;
NewVu1DropGsKick = 0x0;
NewVu1DropGsKickWide = 0x28;

/* Original VU1 microcode packet labels in .vudata (EE addresses). Each
 * PacketSize... word is the packet's quadword count for the DMA ref tag and
 * PacketData... the VIF packet after it. The packets stay an uncredited blob;
 * only the names are transported. */
PROVIDE(PacketSizeNewVu1MicroCode = 0x4AE5A0);
PROVIDE(PacketDataNewVu1MicroCode = 0x4AE5B0);
PROVIDE(PacketSizeNewVu1TexEnvMicroCode = 0x4B0A40);
PROVIDE(PacketDataNewVu1TexEnvMicroCode = 0x4B0A50);
PROVIDE(PacketSizeNewVu1EnvMicroCode = 0x4B19E0);
PROVIDE(PacketDataNewVu1EnvMicroCode = 0x4B19F0);
PROVIDE(PacketSizeNewVu1ProMicroCode = 0x4B54A0);
PROVIDE(PacketDataNewVu1ProMicroCode = 0x4B54B0);
PROVIDE(PacketSizeNewVu1AddMicroCode = 0x4B6F70);
PROVIDE(PacketDataNewVu1AddMicroCode = 0x4B6F80);
PROVIDE(PacketSizeNewVu1AddEnvMicroCode = 0x4B9700);
PROVIDE(PacketDataNewVu1AddEnvMicroCode = 0x4B9710);
PROVIDE(PacketSizeNewVu1DropMicroCode = 0x4BD490);
PROVIDE(PacketDataNewVu1DropMicroCode = 0x4BD4A0);
